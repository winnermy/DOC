## my/Linux内核安全相关资料/lsm安全钩子/mylsm/Kconfig
```kconfig
config SECURITY_MYLSM
    bool "my first security module"
    depends on SECURITY && SECURITYFS
    default y
    help
        Add my first security module for test and studing.
```
